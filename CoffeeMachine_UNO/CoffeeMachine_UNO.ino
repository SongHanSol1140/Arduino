/*
UNO 
13 SCK  흰
12 MISO
11 MOSI 초록
10 SS
*/
#include <SPI.h>
#include <SoftwareSerial.h>
SoftwareSerial Serial2(2,3);    // 2:RX 3:TX
#define resetPin 4
volatile int buf[18];
volatile int pos;
volatile bool active;   
/*//////////////////////////////
코드 입력하는 법 : 0x00 <- 앞에 0x 를 붙이고 뒤에 16진수 2자리 
*/
const int powerOff[14] ={0xF0, 0x0C, 0x01, 0x2A, 0x00, 0x00, 0x00, 0x00, 0x23, 0x01, 0x00, 0x38, 0xD6, 0x73};//
const int powerOff1[14] = {0xF0, 0x0C, 0x01, 0x2A, 0x00, 0x00, 0x00, 0x00, 0x21, 0x01, 0x00, 0x56, 0xB6, 0x73};
const int powerOff2[14] = {0xF0, 0x0C, 0x01, 0x2A, 0x00, 0x00, 0x00, 0x00, 0x21, 0x01, 0x00, 0x56, 0xB6, 0x00};
const int normal[14] = {0xF0, 0x0C, 0x01, 0x31, 0x00, 0x00, 0x00, 0x00, 0x23, 0x01, 0x00, 0xD3, 0xCD, 0x73};//
const int normal1[14] = {0xF0, 0x0C, 0x01, 0x31, 0x00, 0x00, 0x00, 0x00, 0x23, 0x01, 0x00, 0xD3, 0xCD, 0x00};
const int noWater[14] = {0xF0, 0x0C, 0x01, 0x31 ,0x00, 0x00, 0x01, 0x00, 0x63, 0x01, 0x00, 0x64, 0x31, 0x73};
const int noWater1[14] = {0xF0, 0x0C, 0x01, 0x31, 0x00, 0x00, 0x01, 0x00, 0x63, 0x01, 0x00, 0x64, 0x31, 0x00};//F0 C 1 31 0 0 1 0 63 1 0 64 31 0
const int waterLocation[14] = {0xF0, 0x0C, 0x01, 0x31, 0x00, 0x00, 0x00, 0x00, 0x33, 0x01, 0x00, 0x90, 0xAE, 0x73};
const int waterLocation1[14] = {0xF0, 0x0C, 0x01, 0x31, 0x00, 0x00, 0x00, 0x00, 0x33, 0x01, 0x00, 0x90, 0xAE, 0x00};//F0 C 1 31 0 0 0 0 33 1 0 90 AE 0
const int junkContainerFull[14] = {0xF0, 0x0C, 0x01, 0x31, 0x00, 0x00, 0x02, 0x00, 0x23, 0x01, 0x00, 0x97, 0x4E, 0x73};
const int junkContainerLocation[14] = {0xF0, 0x0C, 0x01, 0x31, 0x00, 0x00, 0x00, 0x00, 0x2B, 0x01, 0x00, 0x7A, 0x6C, 0x73};//
const int junkContainerLocation1[14] = {0xF0, 0x0C, 0x01, 0x31, 0x00, 0x00, 0x01, 0x00, 0x6B, 0x01, 0x00, 0xCD, 0x90, 0x00};//F0 C 1 31 0 0 1 0 6B 1 0 CD 90 0
const int noBeans[14] = {0xF0, 0x0C, 0x01, 0x04, 0x00, 0x0A, 0x20, 0x00, 0x25, 0x01, 0x64, 0xCD, 0x9B, 0x73};//F0 C 1 4 0 A 20 0 25 1 64 CD 9B 73 
const int noBeans1[14] = {0xF0, 0x0C, 0x01, 0x04, 0x00, 0x0A, 0x21, 0x00, 0x65, 0x01, 0x64, 0x7A, 0x67, 0x00};//F0 C 1 4 0 A 21 0 65 1 64 7A 67 0//F0 C 1 4 0 A 20 0 25 1 64 CD 9B 0
const int noBeans2[14] = {0xF0, 0x0C, 0x01, 0x05, 0x00, 0x0A, 0x20, 0x00, 0x25, 0x01, 0x64, 0x8A, 0x48, 0x70};//F0 C 1 5 0 A 20 0 25 1 64 8A 48 70
const int noBeans3[14] = {0xF0, 0x0C, 0x01, 0x03, 0x00, 0x0A, 0x20, 0x00, 0x25, 0x01, 0x00, 0x26, 0xA1, 0x73};//F0 C 1 3 0 A 20 0 25 1 0 26 A1 73
const int noBeans4[14] = {0xF0, 0x0C, 0x01, 0x06, 0x00, 0x0A, 0x20, 0x00, 0x25, 0x01, 0x64, 0x42, 0x3D, 0x73};//F0 C 1 6 0 A 20 0 25 1 64 42 3D 73
const int noBeans5[14] = {0xF0, 0x0C, 0x01, 0x03, 0x00, 0x0A, 0x20, 0x00, 0x25, 0x01, 0x64, 0x0A, 0x83, 0x00};//F0 C 1 6 0 A 20 0 25 1 64 42 3D 73
// F0 C 1 3 0 A 20 0 25 1 64 A 83 0
// F0 C 1 3 0 A 20 0 25 1 64 A 83 0
const int noGroundBeans[14] = {0x01, 0x01, 0x00, 0x00, 0x00, 0x00, 0x00, 0x00, 0x00, 0x00, 0x00, 0x00, 0x00, 0x00 };
const int removeCalcite[14] = {0x01, 0x01, 0x00, 0x00, 0x00, 0x00, 0x00, 0x00, 0x00, 0x00, 0x00, 0x00, 0x00, 0x00};
const int overGrounded[14] = {0x01, 0x01, 0x00, 0x00, 0x00, 0x00, 0x00, 0x00, 0x00, 0x00, 0x00, 0x00, 0x00, 0x00};
const int groundLongCoffee[14] = {0x01, 0x01, 0x00, 0x00, 0x00, 0x00, 0x00, 0x00, 0x00, 0x00, 0x00, 0x00, 0x00, 0x00};
const int tooMuchCoffee[14] = {0x01, 0x01, 0x00, 0x00, 0x00, 0x00, 0x00, 0x00, 0x00, 0x00, 0x00, 0x00, 0x00, 0x00};
const int emptyPipe[14] = {0x01, 0x01, 0x00, 0x00, 0x00, 0x00, 0x00, 0x00, 0x00, 0x00, 0x00, 0x00, 0x00, 0x00};
const int tooDirty[14] = {0x01, 0x01, 0x00, 0x00, 0x00, 0x00, 0x00, 0x00, 0x00, 0x00, 0x00, 0x00, 0x00, 0x00};
const int extractorLocation[14] = {0x01, 0x01, 0x00, 0x00, 0x00, 0x00, 0x00, 0x00, 0x00, 0x00, 0x00, 0x00, 0x00, 0x00};
const int steam_[14] = {0x01, 0x01, 0x00, 0x00, 0x00, 0x00, 0x00, 0x00, 0x00, 0x00, 0x00, 0x00, 0x00, 0x00};
const int removeCalcite2[14] = {0x01, 0x01, 0x00, 0x00, 0x00, 0x00, 0x00, 0x00, 0x00, 0x00, 0x00, 0x00, 0x00, 0x00};
char data;

volatile unsigned long nowTime;
volatile unsigned long preTime;

int found;
int strIndex[] = { 0, -1 };
int maxIndex;
int i;
int j;


String Split(String data, char separator, int index)
{
    found = 0;
    strIndex;
    maxIndex = data.length() - 1;

    for (i = 0; i <= maxIndex && found <= index; i++) {
        if (data.charAt(i) == separator || i == maxIndex) {
            found++;
            strIndex[0] = strIndex[1] + 1;
            strIndex[1] = (i == maxIndex) ? i+1 : i;
        }
    }
    return found > index ? data.substring(strIndex[0], strIndex[1]) : "";
}

ISR(SPI_STC_vect){
  byte c = SPDR; // read byte from SPI Data Register
  if(c == 0xF0 || pos == 14){
    pos = 0;
    buf[pos] = c;
  }
  else{
    buf[pos] = c;
  }
  pos++;
}

bool compare(volatile int a[], const int b[]){
  for(j=0; j<13; j++){
    if(a[j] != b[j]){
      return 0;
    }
  }
  return 1;
}


void setup(){
  Serial.begin(115200);
  Serial2.begin(9600);
  pinMode(MISO,OUTPUT);
  pinMode(MOSI,INPUT);
  pinMode(SCK,INPUT);
  pinMode(SS,INPUT);

  digitalWrite(resetPin,HIGH);
  pinMode(resetPin,OUTPUT);

  Serial.println("RESETTED RESETTED RESETTED");

  SPCR |= _BV(SPE);
  SPCR &= ~_BV(MSTR);
  SPCR |= _BV(SPIE);
}
void reset(){
  Serial.println("RESETTING ! ! !");

  digitalWrite(resetPin,LOW);
}
void loop(){
  nowTime = millis();
  Serial.println("Test1");
  if(nowTime - preTime >= 1000){
    reset();
  }
  Serial.println("Test2");
  if(pos == 13){
  Serial.println("Test3");
    Serial.println("");
    for(int i = 0; i<14;i++){
      Serial.print(buf[i],HEX);
      Serial.print(" ");
    }
    if(buf[0] == 0xF0){
      preTime = nowTime;
    }
    if(compare(buf,normal)){
      Serial.print("NORMAL");
      Serial2.write(0x10);
    }
    else if(compare(buf,normal1)){
      Serial.print("NORMAL1");
      Serial2.write(0x10);
    }
    else if(compare(buf,powerOff)){
      Serial.print("POWER OFF");
      Serial2.write(0x11);
    }
    else if(compare(buf,powerOff1)){
      Serial.print("POWER OFF1");
      Serial2.write(0x11);
    }
    else if(compare(buf,powerOff2)){
      Serial.print("POWER OFF2");
      Serial2.write(0x11);
    }
    else if(compare(buf,noWater) || compare(buf,noWater1)){
      Serial.print("no water");
      Serial2.write(0x01);
    }
    else if(compare(buf,waterLocation) || compare(buf,waterLocation1)){
      Serial.print("water location");
      Serial2.write(0x02);
    }
    else if(compare(buf,junkContainerFull)){
      Serial.print("junkcontainerfull");
      Serial2.write(0x03);
    }
    else if(compare(buf,junkContainerLocation) || compare(buf,junkContainerLocation1)){
      Serial.print("junk container location");
      Serial2.write(0x04);
    }
    else if(compare(buf,noBeans) || compare(buf,noBeans1) || compare(buf,noBeans2) || compare(buf,noBeans3) || compare(buf,noBeans4) || compare(buf, noBeans5)){
      Serial.print("no beans");
      Serial2.write(0x05);
    }
    else if(compare(buf,noGroundBeans)){
      Serial.print("no ground beans");
      Serial2.write(0x06);
    }
    else if(compare(buf,removeCalcite)){
      Serial.print("remove calcite");
      Serial2.write(0x07);
    }
    else if(compare(buf,overGrounded)){
      Serial.print("over grounded");
      Serial2.write(0x08);
    }
    else if(compare(buf,groundLongCoffee)){
      Serial.print("groudn long coffee");
      Serial2.write(0x09);
    }
    else if(compare(buf,tooMuchCoffee)){
      Serial.print("too much coffee");
      Serial2.write(0x0A);
    }
    else if(compare(buf,emptyPipe)){
      Serial.print("empty pipe");
      Serial2.write(0x0B);
    }
    else if(compare(buf,tooDirty)){
      Serial.print("too dirty");
      Serial2.write(0x0C);
    }
    else if(compare(buf,extractorLocation)){
      Serial.print("extracgtor location");
      Serial2.write(0x0D);
    }
    else if(compare(buf,steam_)){
      Serial.print("steam");
      Serial2.write(0x0E);
    }
    else if(compare(buf,removeCalcite2)){
      Serial.print("remove calcite2");
      Serial2.write(0x0F);
    }
    else{
      Serial.print("Operating");
      Serial2.write(0x20);
    }
    
  }
    delay(100);
}